## meta-imx-sdk/conf/distro/include/fsl-imx-preferred-env.inc
```bitbake
# Use systemd as default init manager
POKY_INIT_MANAGER = "systemd"

# Use virtual-runc as a default container runtime
# runtime: runc, crun, runv, runx
VIRTUAL-RUNTIME_container_runtime = "virtual-runc"
```
